## firmware/main/Kconfig.projbuild
```kconfig
menu "Mapper3D beacon"

config MAPPER_LED_COUNT
    int "Number of LEDs"
    range 1 10000
    default 100

config MAPPER_LED_GPIO
    int "LED data GPIO"
    range 0 39
    default 18

config MAPPER_LED_BRIGHTNESS
    int "LED channel brightness"
    range 1 255
    default 64

config MAPPER_LED_COLOR_ORDER
    string "LED color order (RGB, GRB, BGR, BRG, RBG, GBR)"
    default "GRB"
    help
        The color order for the LEDs. Use the same order as your LED strip (typically GRB for WS2812).

config MAPPER_STARTUP_FLASH_COLORS
    bool "Flash R, G, B on startup for 350ms each"
    default y
    help
        Flash all LEDs in Red, Green, Blue sequence on startup to verify correct color order.

endmenu
```
